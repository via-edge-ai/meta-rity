## meta-rity-bringup/conf/distro/rity-bringup.conf
```bitbake
require conf/distro/rity.inc

DISTRO = "rity-bringup"
DISTRO_NAME = "Rity bringup"

DISTRO_FEATURES:append = " bringup"
DISTRO_FEATURES:remove = " pulseaudio "

PACKAGECONFIG:append:pn-weston-init = " no-idle-timeout"
```

## meta-rity-bsp/conf/distro/rity-bsp.conf
```bitbake
require conf/distro/rity.inc

DISTRO = "rity-bsp"
DISTRO_NAME = "Rity bsp"

DISTRO_FEATURES:append = " systemd pulseaudio demo pam ubsan"
DISTRO_FEATURES_BACKFILL_CONSIDERED += "sysvinit"
DISTRO_FEATURES_FILTER_NATIVESDK:append = " wayland"
VIRTUAL-RUNTIME_init_manager = "systemd"
VIRTUAL-RUNTIME_initscripts = "systemd-compat-units"
VIRTUAL-RUNTIME_vim = "vim"

PACKAGECONFIG:append:pn-weston-init = " no-idle-timeout"

DISTRO_NN_PROVIDER ?= "nnapi-cpu-hal"
DISTRO_NN_PROVIDER:i350 = "${@bb.utils.contains("DISTRO_FEATURES", "nda-mtk", "xtensa-ann-bin", "nnapi-cpu-hal", d)}"
DISTRO_NN_PROVIDER:i500 = "${@bb.utils.contains("DISTRO_FEATURES", "nda-mtk", "xtensa-ann-bin", "nnapi-cpu-hal", d)}"

PREFERRED_PROVIDER_virtual/libvendor-nn-hal ?= "${DISTRO_NN_PROVIDER}"
```

## meta-rity-bsp/conf/layer.conf
```bitbake
# We have a conf and classes directory, add to BBPATH
BBPATH .= ":${LAYERDIR}"

# We have recipes-* directories, add to BBFILES
BBFILES += "${LAYERDIR}/recipes-*/*/*.bb ${LAYERDIR}/recipes-*/*/*.bbappend"

BBFILE_COLLECTIONS += "rity-bsp"
BBFILE_PATTERN_rity-bsp = "^${LAYERDIR}/"
BBFILE_PRIORITY_rity-bsp = "9"

# This should only be incremented on significant changes that will
# cause compatibility issues with other layers
LAYERVERSION_rity-bsp = "1"

LAYERDEPENDS_rity-bsp = " \
	core \
	mediatek-bsp \
	multimedia-layer \
	openembedded-layer \
	networking-layer \
	meta-python \
	nn \
"

LAYERSERIES_COMPAT_rity-bsp = "kirkstone"
```

## meta-rity-demo/conf/distro/rity-demo.conf
```bitbake
require conf/distro/rity.inc

DISTRO = "rity-demo"
DISTRO_NAME = "Rity Demo Layer"

DISTRO_FEATURES:append = " systemd pulseaudio demo pam"
DISTRO_FEATURES_BACKFILL_CONSIDERED += "sysvinit"
DISTRO_FEATURES_FILTER_NATIVESDK:append = " wayland"
VIRTUAL-RUNTIME_init_manager = "systemd"
VIRTUAL-RUNTIME_initscripts = "systemd-compat-units"

PACKAGECONFIG:append:pn-weston-init = " no-idle-timeout"

PACKAGE_CLASSES ?= "package_deb"
PACKAGE_FEED_URIS ?= "http://192.168.96.20:9876"
EXTRA_IMAGE_FEATURES:append = " package-management "
```

## meta-rity-demo/conf/layer.conf
```bitbake
# We have a conf and classes directory, add to BBPATH
BBPATH .= ":${LAYERDIR}"

# We have recipes-* directories, add to BBFILES
BBFILES += "${LAYERDIR}/recipes-*/*/*.bb ${LAYERDIR}/recipes-*/*/*.bbappend"

BBFILE_COLLECTIONS += "rity-demo"
BBFILE_PATTERN_rity-demo = "^${LAYERDIR}/"
BBFILE_PRIORITY_rity-demo = "9"

# This should only be incremented on significant changes that will
# cause compatibility issues with other layers
LAYERVERSION_rity-demo = "1"

LAYERDEPENDS_rity-demo = " \
	core \
	mediatek-bsp \
	mediatek-tsn \
	mediatek-demo \
	multimedia-layer \
	openembedded-layer \
	networking-layer \
	meta-python \
	qt5-layer \
	nn \
"

LAYERSERIES_COMPAT_rity-demo = "kirkstone"
```

## meta-rity-skeleton/conf/machine/i500-skeleton.conf
```bitbake
# WARNING: please update the rity docs if you modify this file

require conf/machine/include/mt8183.inc

# Kernel
KERNEL_DEVICETREE = "mediatek/mt8183-skeleton.dtb"

# U-Boot
UBOOT_ENTRYPOINT       = "0x40200000"
UBOOT_LOADADDRESS      = "0x40200000"
UBOOT_DTB_LOADADDRESS  = "0x44000000"
UBOOT_DTBO_LOADADDRESS = "0x44c00000"
UBOOT_MACHINE = "mt8183_pumpkin_defconfig"

DISTRO_FEATURES_append = " dtbo "
MACHINE_FEATURES_append = " alsa usbgadget usbhost"

MACHINEOVERRIDES =. "mt8183-skeleton:mt8385-skeleton:i500-skeleton:"
```

## meta-rity-vis/conf/distro/rity-vis.conf
```bitbake
require conf/distro/rity.inc

DISTRO = "rity-vis"
DISTRO_NAME = "VIA Intelligent Solutions Layer"

DISTRO_FEATURES:append = " systemd pulseaudio demo pam ubsan fwupdate"
DISTRO_FEATURES_BACKFILL_CONSIDERED += "sysvinit"
DISTRO_FEATURES_FILTER_NATIVESDK:append = " wayland"
VIRTUAL-RUNTIME_init_manager = "systemd"
VIRTUAL-RUNTIME_initscripts = "systemd-compat-units"
VIRTUAL-RUNTIME_vim = "vim"

PACKAGECONFIG:append:pn-weston-init = " no-idle-timeout"

PACKAGE_CLASSES ?= "package_deb"
PACKAGE_FEED_URIS ?= "http://192.168.96.20:9876"
EXTRA_IMAGE_FEATURES:append = " package-management "

DISTRO_NN_PROVIDER ?= "nnapi-cpu-hal"
DISTRO_NN_PROVIDER:i350 = "${@bb.utils.contains("DISTRO_FEATURES", "nda-mtk", "xtensa-ann-bin", "nnapi-cpu-hal", d)}"
DISTRO_NN_PROVIDER:i500 = "${@bb.utils.contains("DISTRO_FEATURES", "nda-mtk", "xtensa-ann-bin", "nnapi-cpu-hal", d)}"

PREFERRED_PROVIDER_virtual/libvendor-nn-hal ?= "${DISTRO_NN_PROVIDER}"
IMAGE_ROOTFS_EXTRA_SPACE = "7500000"
```

## meta/conf/distro/rity.inc
```bitbake
require conf/distro/poky.conf

DISTRO = "rity"
DISTRO_NAME = "Rity"
DISTRO_VERSION = "23.0-ea-release"

WKS_FILE = "rity.wks.in"
IMAGE_HOME_SIZE = "200M"

# Boot configuration tweaks
KERNEL_CLASSES = "kernel-fitimage-mtk kernel-mod-image"
UBOOT_ENV_SUFFIX = "script"
UBOOT_ENV = "boot"
include conf/machine/include/rity-${MACHINE}.inc
```

## meta/recipes-bsp/u-boot/files/boot.script.its
```
/dts-v1/;

/ {
        description = "Boot script to be embedded";
        #address-cells = <1>;

        images {
                default = "bootscr-boot.script";
                bootscr-boot.script {
                        description = "U-boot script";
                        data = /incbin/("boot.script");
                        type = "script";
                        arch = "arm64";
                        compression = "none";
                        hash-1 {
                                algo = "sha256";
                        };
                };
	};
};
```
